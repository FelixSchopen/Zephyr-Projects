## prj.conf
```kconfig
# Peripherals
CONFIG_GPIO=y
CONFIG_PWM=y
CONFIG_USB_DEVICE_DRIVER=y

# Systemview
CONFIG_SEGGER_SYSTEMVIEW=y
CONFIG_TRACING=y
```

## stm32f4_disco.overlay
```dts
/ {
    
};

usb: &usbotg_fs {
	status = "okay";
};


can1: &can1 {
	pinctrl-0 = <&can1_rx_pb8 &can1_tx_pb9>;
	pinctrl-names = "default";
	bus-speed = <125000>;
	status = "okay";
};
```

## src/main.c
```c
/*
 * Copyright (c) 2016 Intel Corporation
 *
 * SPDX-License-Identifier: Apache-2.0
 */

#include <zephyr/kernel.h>
#include <zephyr/device.h>
#include <zephyr/drivers/gpio.h>
#include <zephyr/drivers/pwm.h>
#include <zephyr/drivers/can.h>
#include <zephyr/devicetree.h>
#include <zephyr/net/mqtt.h>
#include <zephyr/drivers/usb/usb_dc.h>

#include "SEGGER_RTT.h"

const struct device* usb_dev = DEVICE_DT_GET(DT_NODELABEL(usb));

void main(void){ 
   if(usb_dc_attach() != 0){
      SEGGER_RTT_WriteString(0, "Error\n");
   }
   else {
      SEGGER_RTT_WriteString(0, "Success\n");
   }
   while(1){
      
   }
}
```
