## prj.conf
```kconfig
CONFIG_GPIO=y
CONFIG_PWM=y
CONFIG_SEGGER_SYSTEMVIEW=y
CONFIG_TRACING=y
CONFIG_USE_SEGGER_RTT=y


CONFIG_THREAD_NAME=y
CONFIG_USE_SEGGER_RTT=y
CONFIG_SEGGER_SYSTEMVIEW_BOOT_ENABLE=y
CONFIG_STDOUT_CONSOLE=y
```

## src/main.c
```c
/*
 * Copyright (c) 2017 Linaro Limited
 *
 * SPDX-License-Identifier: Apache-2.0
 */

#include "../include/setup.h"

void t_button(void){
	while(1){
		if(button_pressed){
			SEGGER_RTT_WriteString(0, "Button pressed!\n");
			gpio_pin_toggle_dt(&itr_led_spec);
			if(!deadlock){
				deadlock = 1;
			}
			else{
				mutex1 = 1;
				mutex2 = 1;
				deadlock = 0;
			}
			k_msleep(150);
			button_pressed = 0;
		}
		k_msleep(10);
	}
}

void t_servo(void){
	while(1){
		pwm_set(pwm_servo, 1, PWM_USEC(20000), PWM_USEC(pwm_pulse), PWM_POLARITY_NORMAL);
		k_msleep(50);
	}
}


void t_led1(void){
	while(1){
		if(deadlock){
			// Try to lock mutex1
			while(mutex1 != 1) {
				k_usleep(0.1);
			}
			mutex1 = 0;

			k_usleep(1);

			// Try to lock mutex2
			while(mutex2 != 1){
				k_usleep(0.1);
			}
			mutex2 = 0;
			
			gpio_pin_toggle_dt(&orange_led_3_spec);
			
			// Unlock mutexes
			mutex1 = 1;
			mutex2 = 1;
		} 
		else{
			gpio_pin_toggle_dt(&orange_led_3_spec);
		}
		k_msleep(50);
	}
}

void t_led2(void){
	while(1){
		if(deadlock){
			k_msleep(1);
			// Try to lock mutex2
			while(mutex2 != 1) {
				k_usleep(0.1);
			}
			mutex2 = 0;

			// Try to lock mutex1
			while(mutex1 != 1){
				k_usleep(0.1);
			}
			mutex1 = 0;

			gpio_pin_toggle_dt(&blue_led_6_spec);
			
			// Unlock mutexes
			mutex2 = 1;
			mutex1 = 1;
		}
		else {
			gpio_pin_toggle_dt(&blue_led_6_spec);
		}
		k_msleep(50);
	}
}

K_THREAD_DEFINE(button, 1024, t_button, NULL, NULL, NULL, -7, 0, 0);
K_THREAD_DEFINE(servo, 1024, t_servo, NULL, NULL, NULL, -3, 0, 0);
K_THREAD_DEFINE(led1, 1024, t_led1, NULL, NULL, NULL, -5, 0, 0);
K_THREAD_DEFINE(led2, 1024, t_led2, NULL, NULL, NULL, -5, 0, 0);


void main(void){
	setup();
}
```

## include/isr.h
```c
void isr_button(void);
void isr_rotary_encoder(void);
void isr_usr_button(void);
```

## include/setup.h
```c
#include <zephyr/kernel.h>
#include <zephyr/device.h>
#include <zephyr/drivers/gpio.h>
#include <zephyr/drivers/pwm.h>
#include <zephyr/devicetree.h>
#include <stdio.h>
#include "isr.h"
#include "SEGGER_RTT.h"

#define SERVO_MAX_PULSE 2400
#define SERVO_MIN_PULSE 600

// GPIO specs
extern const struct gpio_dt_spec clk_spec;
extern const struct gpio_dt_spec dt_spec;
extern const struct gpio_dt_spec sw_spec;
extern const struct gpio_dt_spec itr_button_spec;
extern const struct gpio_dt_spec itr_led_spec;
extern const struct gpio_dt_spec orange_led_3_spec;
extern const struct gpio_dt_spec blue_led_6_spec;
extern const struct gpio_dt_spec user_button_spec;

// Devices
extern const struct device* pwm_servo;

// Interrupt callback data
extern struct gpio_callback cb_data;
extern struct gpio_callback cb_data2;
extern struct gpio_callback cb_data3;


// Basic Variables
extern uint8_t button_pressed;
extern uint8_t rotary_encoder_rdy;
extern uint8_t deadlock;
extern gpio_pin_t clk_last; 
extern gpio_pin_t clk;
extern gpio_pin_t dt;
extern uint16_t pwm_pulse;

// Mutex
extern uint8_t mutex1;
extern uint8_t mutex2;

extern struct k_sem my_sem1;


// Setup function
void setup(void);
```

## src/isr.c
```c
#include "../include/isr.h"
#include "../include/setup.h"

// Button
void isr_button(void){
    button_pressed = 1;
}

// Rotary Encoder
void isr_rotary_encoder(void){
	clk = gpio_pin_get_raw(clk_spec.port, clk_spec.pin);
	dt = gpio_pin_get_raw(dt_spec.port, dt_spec.pin);
	if(clk != clk_last){
		if(dt != clk){			
			if(pwm_pulse < 2400){
				pwm_pulse+=120;
			}
		}
		else{
			if(pwm_pulse > 600){
				pwm_pulse-=120;
			}
		}
	}
	clk_last = clk;
}
```

## src/setup.c
```c
#include "../include/setup.h"

const struct gpio_dt_spec clk_spec = GPIO_DT_SPEC_GET(DT_NODELABEL(clk), gpios);
const struct gpio_dt_spec dt_spec = GPIO_DT_SPEC_GET(DT_NODELABEL(dt), gpios);
const struct gpio_dt_spec sw_spec = GPIO_DT_SPEC_GET(DT_NODELABEL(sw), gpios);
const struct gpio_dt_spec itr_button_spec = GPIO_DT_SPEC_GET(DT_NODELABEL(itr_button), gpios);
const struct gpio_dt_spec itr_led_spec = GPIO_DT_SPEC_GET(DT_NODELABEL(itr_led), gpios);
const struct gpio_dt_spec orange_led_3_spec = GPIO_DT_SPEC_GET(DT_NODELABEL(orange_led_3), gpios);
const struct gpio_dt_spec blue_led_6_spec = GPIO_DT_SPEC_GET(DT_NODELABEL(blue_led_6), gpios);

const struct device* pwm_servo = DEVICE_DT_GET(DT_NODELABEL(servo));

struct k_mutex resource_mutex1;
struct k_mutex resource_mutex2;
struct k_mutex mutex3;
uint8_t mutex4 = 1;


// Interrupt callback data
struct gpio_callback cb_data;
struct gpio_callback cb_data2;

// Basic Variables
uint8_t button_pressed = 0;
uint8_t rotary_encoder_rdy = 1;
uint8_t deadlock = 0;
gpio_pin_t clk_last; 
gpio_pin_t clk;
gpio_pin_t dt;
uint16_t pwm_pulse = 600;

// Integer mutex for deadlock
uint8_t mutex1 = 1;
uint8_t mutex2 = 1;

struct k_sem my_sem1;

void setup(void){

    gpio_pin_configure_dt(&clk_spec, GPIO_INPUT);
    gpio_pin_configure_dt(&dt_spec, GPIO_INPUT);
    gpio_pin_configure_dt(&sw_spec, GPIO_INPUT);
    gpio_pin_configure_dt(&itr_led_spec, GPIO_OUTPUT_ACTIVE);
    gpio_pin_configure_dt(&itr_button_spec, GPIO_INPUT);

    gpio_pin_configure_dt(&orange_led_3_spec, GPIO_OUTPUT_INACTIVE);
    gpio_pin_configure_dt(&blue_led_6_spec, GPIO_OUTPUT_INACTIVE);

	gpio_pin_interrupt_configure_dt(&itr_button_spec, GPIO_INT_EDGE_TO_ACTIVE);
    gpio_init_callback(&cb_data, (gpio_callback_handler_t)isr_button, BIT(itr_button_spec.pin));
	gpio_add_callback(itr_button_spec.port, &cb_data);

	gpio_pin_interrupt_configure_dt(&clk_spec, GPIO_INT_EDGE_BOTH);
    gpio_init_callback(&cb_data2, (gpio_callback_handler_t)isr_rotary_encoder, BIT(clk_spec.pin));
	gpio_add_callback(clk_spec.port, &cb_data2);

	clk_last = gpio_pin_get_raw(clk_spec.port, clk_spec.pin); 

    k_sem_init(&my_sem1, 0, 1);
}
```
