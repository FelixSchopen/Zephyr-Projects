## prj.conf
```kconfig
CONFIG_GPIO=y


CONFIG_TRACING=y
CONFIG_SEGGER_SYSTEMVIEW=y
```

## stm32f4_disco.overlay
```dts
/ {
    
};
```

## src/main.c
```c
/*
 * Copyright (c) 2016 Intel Corporation
 *
 * SPDX-License-Identifier: Apache-2.0
 */

#include <zephyr/kernel.h>
#include <zephyr/drivers/gpio.h>

#include "SEGGER_RTT_printf.c"




void main(void){ 
}
```
